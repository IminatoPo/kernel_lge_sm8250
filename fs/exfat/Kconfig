## fs/exfat/Kconfig
```kconfig
# SPDX-License-Identifier: GPL-2.0-or-later

config EXFAT_FS
	tristate "exFAT filesystem support"
	select NLS
	help
	  This allows you to mount devices formatted with the exFAT file system.
	  exFAT is typically used on SD-Cards or USB sticks.

	  To compile this as a module, choose M here: the module will be called
	  exfat.

config EXFAT_DEFAULT_IOCHARSET
	string "Default iocharset for exFAT"
	default "utf8"
	depends on EXFAT_FS
	help
	  Set this to the default input/output character set to use for
	  converting between the encoding is used for user visible filename and
	  UTF-16 character that exfat filesystem use, and can be overridden with
	  the "iocharset" mount option for exFAT filesystems.

config EXFAT_COMPAT_TUXERA
	bool "Tuxera compatibility for EXFAT"
	default n
	depends on EXFAT_FS
	help
	  Say Y here for the exFAT driver to register as texfat and
	  to support extra mount options for drop-in replacement on
	  systems previously using Tuxera's commercial exFAT driver.

	  If you are building exFAT as a module, this will change
	  the module's name to texfat.
```
